## layers/meta-ros2-demo-image/conf/layer.conf
```bitbake
# We have a conf and classes directory, append to BBPATH
BBPATH .= ":${LAYERDIR}"

# We have a recipes directory, add to BBFILES
BBFILES += "${LAYERDIR}/recipes-*/*/*.bb ${LAYERDIR}/recipes-*/*/*.bbappend ${LAYERDIR}/generated-recipes/*/*.bb"

BBFILE_COLLECTIONS += "ros2-demo-iamge"
BBFILE_PATTERN_ros2-demo-iamge := "^${LAYERDIR}/"
BBFILE_PRIORITY_ros2-demo-iamge = "12"

LAYERVERSION_ros2-demo-iamge = "1"

LAYERDEPENDS_ros2-demo-iamge = " \
    core \
    meta-python \
    openembedded-layer \
    ros-common-layer \
    ros2-layer \
"

LAYERSERIES_COMPAT_ros2-demo-iamge = "${ROS_OE_RELEASE_SERIES}"

require conf/ros-distro/include/iron/ros-distro.inc
```
